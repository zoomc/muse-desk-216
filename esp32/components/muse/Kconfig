## esp32/components/muse/Kconfig
```kconfig
# Copyright (c) Meta Platforms, Inc. and affiliates.
#
# Licensed under the Apache License, Version 2.0 (the "License");
# you may not use this file except in compliance with the License.
# You may obtain a copy of the License at
#
#     http://www.apache.org/licenses/LICENSE-2.0
#
# Unless required by applicable law or agreed to in writing, software
# distributed under the License is distributed on an "AS IS" BASIS,
# WITHOUT WARRANTIES OR CONDITIONS OF ANY KIND, either express or implied.
# See the License for the specific language governing permissions and
# limitations under the License.

menu "Muse"

    choice MUSE_BOARD
        prompt "Board with the full UI"
        default MUSE_BOARD_NONE
        help
            The UI is the voice companion on boards with a screen: an
            animated avatar, push-to-talk chat, settings, and battery
            handling. It runs beside Home Link, which owns Wi-Fi, BLE
            pairing, credentials and OTA. Pick the board it runs on, or none
            for a Link without a display.

        config MUSE_BOARD_NONE
            bool "None (Home Link without a display)"

        config MUSE_BOARD_WAVESHARE_S3_175C
            bool "Waveshare ESP32-S3-Touch-AMOLED-1.75C"
            depends on IDF_TARGET_ESP32S3

        config MUSE_BOARD_WAVESHARE_S3_175
            bool "Waveshare ESP32-S3-Touch-AMOLED-1.75 (not the 1.75C)"
            depends on IDF_TARGET_ESP32S3

        config MUSE_BOARD_WAVESHARE_S3_216
            bool "Waveshare ESP32-S3-Touch-AMOLED-2.16"
            depends on IDF_TARGET_ESP32S3

        config MUSE_BOARD_AIPI
            bool "AIPI Lite (ESP32-S3, two buttons, no touch)"
            depends on IDF_TARGET_ESP32S3

        config MUSE_BOARD_ESPRESSIF_BOX_3
            bool "Espressif ESP32-S3-BOX-3 (320x240 touch LCD, speaker and microphones)"
            depends on IDF_TARGET_ESP32S3

        config MUSE_BOARD_WAVESHARE_C6_18
            bool "Waveshare ESP32-C6-Touch-AMOLED-1.8"
            depends on IDF_TARGET_ESP32C6

        config MUSE_BOARD_WAVESHARE_C6_206
            bool "Waveshare ESP32-C6-Touch-AMOLED-2.06"
            depends on IDF_TARGET_ESP32C6

        config MUSE_BOARD_SENSECAP_WATCHER
            bool "Seeed SenseCAP Watcher (ESP32-S3, round touch LCD, wheel)"
            depends on IDF_TARGET_ESP32S3

        config MUSE_BOARD_M5STACK_CARDPUTER_ADV
            bool "M5Stack Cardputer ADV (ESP32-S3, keyboard, no PSRAM)"
            depends on IDF_TARGET_ESP32S3

        config MUSE_BOARD_M5STACK_STICKS3
            bool "M5Stack StickS3 (ESP32-S3, two buttons, no touch)"
            depends on IDF_TARGET_ESP32S3

        config MUSE_BOARD_M5STACK_STICKC_PLUS2
            bool "M5Stack StickC Plus2 (ESP32, two buttons, no touch)"
            depends on IDF_TARGET_ESP32

        config MUSE_BOARD_M5STACK_STOPWATCH
            bool "M5Stack StopWatch (ESP32-S3, round touch AMOLED)"
            depends on IDF_TARGET_ESP32S3

        config MUSE_BOARD_M5STACK_CORES3
            bool "M5Stack CoreS3 (ESP32-S3, 320x240 touch LCD, speaker and microphones)"
            depends on IDF_TARGET_ESP32S3

        config MUSE_BOARD_M5STACK_CORE2
            bool "M5Stack Core2 v1.0 (ESP32, touch LCD, touch-strip talk)"
            depends on IDF_TARGET_ESP32
        config MUSE_BOARD_FNK0104B
            bool "Freenove FNK0104B (ESP32-S3, 240x320 touch LCD, ES8311 speaker and mic)"
            depends on IDF_TARGET_ESP32S3
        config MUSE_BOARD_GUITION_JC3248W535
            bool "Guition JC3248W535 (ESP32-S3, 3.5\" 320x480 touch LCD, speaker)"
            depends on IDF_TARGET_ESP32S3

        config MUSE_BOARD_WAVESHARE_S3_LCD7
            bool "Waveshare ESP32-S3-Touch-LCD-7 (800x480 touch LCD, no audio)"
            depends on IDF_TARGET_ESP32S3
        config MUSE_BOARD_VN_S3_183
            bool "VN ESP32-S3 board (1.83\" 284x240 NV3023 LCD, ES8311 and ES7210)"
            depends on IDF_TARGET_ESP32S3
        config MUSE_BOARD_AI_PASSPORT
            bool "FoloToy AI Passport (ESP32-C3, three buttons, no touch)"
            depends on IDF_TARGET_ESP32C3
    endchoice

    config MUSE_ENABLED
        bool
        default y if !MUSE_BOARD_NONE

    # Always defined, unlike the target-dependent board options, so
    # idf_component.yml rules can select each board's managed components.
    config MUSE_BOARD_ID
        string
        default "waveshare_s3_175c" if MUSE_BOARD_WAVESHARE_S3_175C
        default "waveshare_s3_175" if MUSE_BOARD_WAVESHARE_S3_175
        default "waveshare_s3_216" if MUSE_BOARD_WAVESHARE_S3_216
        default "aipi" if MUSE_BOARD_AIPI
        default "espressif_box_3" if MUSE_BOARD_ESPRESSIF_BOX_3
        default "waveshare_c6_18" if MUSE_BOARD_WAVESHARE_C6_18
        default "waveshare_c6_206" if MUSE_BOARD_WAVESHARE_C6_206
        default "sensecap_watcher" if MUSE_BOARD_SENSECAP_WATCHER
        default "m5stack_sticks3" if MUSE_BOARD_M5STACK_STICKS3
        default "m5stack_stickc_plus2" if MUSE_BOARD_M5STACK_STICKC_PLUS2
        default "m5stack_cardputer_adv" if MUSE_BOARD_M5STACK_CARDPUTER_ADV
        default "m5stack_stopwatch" if MUSE_BOARD_M5STACK_STOPWATCH
        default "m5stack_cores3" if MUSE_BOARD_M5STACK_CORES3
        default "m5stack_core2" if MUSE_BOARD_M5STACK_CORE2
        default "fnk0104b" if MUSE_BOARD_FNK0104B
        default "guition_jc3248w535" if MUSE_BOARD_GUITION_JC3248W535
        default "waveshare_s3_lcd7" if MUSE_BOARD_WAVESHARE_S3_LCD7
        default "vn_s3_183" if MUSE_BOARD_VN_S3_183
        default "ai_passport" if MUSE_BOARD_AI_PASSPORT
        default "none"

    # The Muse tools' serial port: the console UART behind the board's USB
    # bridge, where the chip's own USB Serial/JTAG isn't wired to a connector
    # (the Watcher's USB-C goes to a CH342) or the chip has none.
    config MUSE_CONSOLE_UART
        bool
        default y if MUSE_BOARD_SENSECAP_WATCHER || MUSE_BOARD_WAVESHARE_S3_LCD7 || !SOC_USB_SERIAL_JTAG_SUPPORTED

    # A board overlay can raise this for a quiet speaker.
    config MUSE_DEFAULT_VOLUME
        int "Speaker volume until one is chosen in settings (percent)"
        range 0 100
        default 70

    config MUSE_WATCHER_CAMERA
        bool "SenseCAP Watcher camera capture and live preview"
        depends on MUSE_BOARD_SENSECAP_WATCHER && SPIRAM
        default n
        help
            Enable the camera.capture Home Link command and the wheel
            double-click camera preview. Camera buffers and tasks consume
            memory and preview decoding shares CPU time with voice and Link.
            Leave disabled to build without camera support.

    config MUSE_CJK_FONT
        bool "Show Chinese and Japanese in captions"
        depends on MUSE_ENABLED
        default n
        help
            Captions fall back to the 16 px CJK bitmap (fonts/muse_font_cjk_16.c,
            Noto Sans CJK SC subset, SIL OFL) for CJK punctuation, kana, the
            GB2312 Han ideographs and fullwidth forms that the ASCII caption
            font lacks. Small screens, whose captions are two lines of 8 px
            text, show a reply with CJK in it one 16 px line at a time.
            Without it those characters show as boxes. Rare Han outside GB2312
            and Hangul aren't included.

    config MUSE_UI_CHINESE
        bool "Chinese interface (captions and menus)"
        depends on MUSE_ENABLED
        select MUSE_CJK_FONT
        default y
        help
            Captions and menus link the CJK bitmap font (box3's
            muse_font_cjk_16: 16 px Noto Sans CJK SC subset, GB2312-level
            6990 glyphs, SIL OFL, see fonts/OFL.txt). Caption paging wraps
            by UTF-8 code point and never splits a multibyte character
            (muse_chat_text.c next_line). Disable for the English-only UI
            with the smaller flash footprint.

    config MUSE_JC3248W535_MIC_GPIO
        int "JC3248W535: GPIO for an external I2S mic's data (SD) line"
        depends on MUSE_BOARD_GUITION_JC3248W535
        range -1 48
        default -1
        help
            The board has a speaker amp but no microphone. Wire an I2S MEMS
            mic such as an INMP441 to the speaker's clocks (SCK to GPIO42, WS
            to GPIO2), L/R to GND, power to 3.3 V, and its SD line to a free
            GPIO, and set that GPIO here. -1 leaves push-to-talk recording
            silence.

    config MUSE_HATCH
        bool "Muse's own voice session"
        depends on MUSE_ENABLED
        default y if SPIRAM
        default n
        help
            Push-to-talk turns go over a voice session of Muse's own, to the
            VM Home Link is paired with or one set up on the device with a
            device token. Replies are text, shown as captions; start_tts in
            muse_chat_session.cpp is where a TTS API of your own can speak
            them. Needs PSRAM. Without it, voice notes go over Home Link's own
            session to its paired VM and replies are shown as text.

    config MUSE_DESK_FEATURES
        bool "HD anime, Pomodoro and Dalian weather"
        depends on MUSE_BOARD_WAVESHARE_S3_216 && SPIRAM
        default n
        help
            Native-resolution anime pictures, a Pomodoro focus timer,
            and directly fetched Dalian weather. Keeps the original settings UI.

    choice MUSE_TTS_BACKEND
        prompt "Spoken replies (TTS backend)"
        depends on MUSE_HATCH
        default MUSE_TTS_BACKEND_EDGE
        help
            How finished replies are spoken. edge (default): a LAN edge-tts
            server over plain HTTP, no key. elevenlabs: ElevenLabs streaming
            MP3 over HTTPS, needs MUSE_ELEVENLABS_API_KEY. off: captions at
            reading pace, no speech. A failed fetch never stalls: it falls
            back to silent captions at reading pace.

        config MUSE_TTS_BACKEND_EDGE
            bool "LAN edge-tts server (default, no key)"

        config MUSE_TTS_BACKEND_MIMO
            bool "Xiaomi MiMo streaming TTS (needs key)"

        config MUSE_TTS_BACKEND_ELEVENLABS
            bool "ElevenLabs streaming TTS (needs key)"

        config MUSE_TTS_BACKEND_OFF
            bool "Off (captions only)"
    endchoice

    config MUSE_MIMO_API_KEY
        string "MiMo API key"
        depends on MUSE_TTS_BACKEND_MIMO
        default ""

    config MUSE_MIMO_URL
        string "MiMo chat completions endpoint"
        depends on MUSE_TTS_BACKEND_MIMO
        default "https://api.xiaomimimo.com/v1/chat/completions"

    config MUSE_MIMO_VOICE
        string "MiMo voice"
        depends on MUSE_TTS_BACKEND_MIMO
        default "茉莉"

    config MUSE_MIMO_STYLE
        string "MiMo speaking style"
        depends on MUSE_TTS_BACKEND_MIMO
        default "用温柔、自然的中文女声说话，语速稍慢，咬字清晰，像亲切的日常交谈。"

    config MUSE_LOCAL_TTS_URL
        string "Local TTS HTTP endpoint"
        depends on MUSE_HATCH && MUSE_TTS_BACKEND_EDGE
        default ""
        help
            A trusted LAN HTTP endpoint accepting UTF-8 text with POST and
            returning audio/mpeg. Replies are sent to this server as text
            (Content-Type text/plain; charset=utf-8, Accept audio/mpeg).

    config MUSE_LOCAL_TTS_TOKEN
        string "Local TTS server token"
        depends on MUSE_HATCH && MUSE_TTS_BACKEND_EDGE
        default ""
        help
            Bearer token the LAN speech server requires on /tts (its
            MUSE_TTS_TOKEN). Empty sends no Authorization header, which the
            server rejects: set the same token on both sides. Like the SDK
            token, it ships inside the firmware: never commit a generated
            sdkconfig.

    config MUSE_ELEVENLABS_API_KEY
        string "ElevenLabs API key for spoken replies"
        depends on MUSE_HATCH
        default ""
        help
            With a key, start_tts sends each reply's text to ElevenLabs'
            streaming text-to-speech and plays the MP3 it returns, captions
            following the speech. The key needs the Text to Speech
            permission. Empty: replies stay text. Like the SDK token, the key
            ships inside the firmware: never commit a generated sdkconfig.

    config MUSE_ELEVENLABS_VOICE_ID
        string "ElevenLabs voice ID"
        depends on MUSE_HATCH
        default "EXAVITQu4vr4xnSDxMaL"
        help
            Any voice in the account's library. The default is the premade
            "Sarah".

    config MUSE_ELEVENLABS_MODEL
        string "ElevenLabs model"
        depends on MUSE_HATCH
        default "eleven_flash_v2_5"
        help
            eleven_flash_v2_5 answers fastest and speaks 32 languages;
            eleven_multilingual_v2 sounds richer but starts later.

endmenu
```
